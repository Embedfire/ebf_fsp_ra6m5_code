#include "hal_data.h"
#include "oled.h"


/***************************16*16的点阵字体取模方式：共阴——列行式——逆向输出*********/
unsigned char F16x16[] =
{
     0x00,0xFE,0x92,0x92,0xFE,0x92,0x92,0xFE,0x00,0x42,0x4A,0xD2,0x6A,0x46,0xC0,0x00,
     0x40,0xC4,0x44,0x44,0x3F,0x24,0x24,0x24,0x00,0x40,0x80,0x7F,0x00,0x01,0x00,0x00,/*"野",0*/

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     0x04,0x44,0x82,0x7F,0x01,0x80,0x80,0x40,0x43,0x2C,0x10,0x28,0x46,0x81,0x80,0x00,/*"技",3*/
};

/************************************6*8的点阵************************************/
const unsigned char F6x8[][6] =

 {
    0x00, 0x00, 0x00, 0x00, 0x00, 0x00,// sp
    0x00, 0x00, 0x00, 0x2f, 0x00, 0x00,// !
    0x00, 0x00, 0x07, 0x00, 0x07, 0x00,// "
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    0x14, 0x14, 0x14, 0x14, 0x14, 0x14,// horiz lines
};

/****************************************8*16的点阵************************************/
const unsigned char F8X16[]=
{
  0x00,0x00,0x00,0x00,0x00,0x00,0x00,0x00,0x00,0x00,0x00,0x00,0x00,0x00,0x00,0x00,// 0
  0x00,0x00,0x00,0xF8,0x00,0x00,0x00,0x00,0x00,0x00,0x00,0x33,0x30,0x00,0x00,0x00,//! 1
  0x00,0x10,0x0C,0x06,0x10,0x0C,0x06,0x00,0x00,0x00,0x00,0x00,0x00,0x00,0x00,0x00,//" 2
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  0x00,0x06,0x01,0x01,0x02,0x02,0x04,0x04,0x00,0x00,0x00,0x00,0x00,0x00,0x00,0x00,//~ 94
};

void OLED_WrCmd(unsigned char cmd)//写命令
{
    uint8_t send_buffer[2] = {};

    OLED_DC(0);
    send_buffer[0] = cmd;
    R_SCI_SPI_Write(&g_spi1_ctrl, &send_buffer[0], 1, SPI_BIT_WIDTH_8_BITS);
    R_BSP_SoftwareDelay(100,BSP_DELAY_UNITS_MICROSECONDS);
}


void OLED_WrDat(unsigned char dat)//写数据
{
    uint8_t send_buffer[2] = {};

    OLED_DC(1);
    send_buffer[0] = dat;
    R_SCI_SPI_Write(&g_spi1_ctrl, &send_buffer[0], 1, SPI_BIT_WIDTH_8_BITS);
    R_BSP_SoftwareDelay(100,BSP_DELAY_UNITS_MICROSECONDS);
}

void OLED_SetPos(unsigned char x, unsigned char y)//设置起始点坐标
{
	OLED_WrCmd(0xb0 + y);
	OLED_WrCmd(((x&0xf0)>>4)|0x10);
	OLED_WrCmd((x&0x0f)|0x01);
}

void OLED_Fill(unsigned char bmp_dat)//全屏填充
{
	unsigned char y,x;
	for(y=0;y<8;y++)
	{
		OLED_WrCmd(0xb0+y);
		OLED_WrCmd(0x00);
		OLED_WrCmd(0x10);
		for(x=0;x<X_WIDTH;x++)
		{
			OLED_WrDat(bmp_dat);
		}
	}
}

void OLED_CLS(void)//清屏
{
	OLED_Fill(0x00);
}

void OLED_Init(void)
{
    OLED_WrCmd(0xAE);//关闭显示
    OLED_WrCmd(0xD5);//设置时钟分频因子
    OLED_WrCmd(0x80);

    OLED_WrCmd(0xA8);//设置驱动路数
    OLED_WrCmd(0x3F);//路数默认0x3F（1/64）

    OLED_WrCmd(0xD3);//设置显示偏移
    OLED_WrCmd(0x00);//偏移默认为0

    OLED_WrCmd(0x40);//设置显示开始行[5:0]

    OLED_WrCmd(0x8D);//电荷泵设置
    OLED_WrCmd(0x14);//bit2，开启/关闭

    OLED_WrCmd(0x20);//设置内存地址模式
    OLED_WrCmd(0x02);//[1:0],00，列地址模式;01，行地址模式;10,页地址模式;默认10;

    //OLED_WrCmd(0xA1);
    OLED_WrCmd(0xA1);//段重定义设置,bit0:0,0->0;1,0->127;
    OLED_WrCmd(0xc8);//设置COM扫描方向;bit3:0,普通模式;1,重定义模式 COM[N-1]->COM0;N:驱动路数
    OLED_WrCmd(0xDA);//设置COM硬件引脚配置
    OLED_WrCmd(0x12);//[5:4]配置

    OLED_WrCmd(0x81);//对比度设置
    OLED_WrCmd(0xEF);//默认0x7F（范围1~255，越大越亮）

    OLED_WrCmd(0xD9);//设置预充电周期
    OLED_WrCmd(0xF1);//[3:0],PHASE 1;[7:4],PHASE 2;

    OLED_WrCmd(0xDB);//设置VCOMH 电压倍率
    OLED_WrCmd(0x30);//[6:4] 000,0.65*vcc;001,0.77*vcc;011,0.83*vcc;

    OLED_WrCmd(0xA4);//全局显示开启;bit0:1,开启;0,关闭;(白屏/黑屏)
    OLED_WrCmd(0xA6);//设置显示方式;bit0:1,反相显示;0,正常显示

    OLED_WrCmd(0xAF);//开启显示


    OLED_CLS();
}

void OLED_6x8Str(unsigned char x, unsigned char y, unsigned char ch[])
{
	unsigned char c=0,i=0,j=0;
	while (ch[j]!='\0')
	{
		c = ch[j]-32;
		if(x>126)
		{
			x=0;y++;
		}
		OLED_SetPos(x,y);
		for(i=0;i<6;i++)
		{
			OLED_WrDat(F6x8[c][i]);
		}
		x+=6;
		j++;
	}
}

void OLED_8x16Str(unsigned char x, unsigned char y, unsigned char ch[])
{
	unsigned char c=0,i=0,j=0;
	while (ch[j]!='\0')
	{
		c =ch[j]-32;
		if(x>120)
		{
			x=0;y++;
		}
		OLED_SetPos(x,y);
		for(i=0;i<8;i++)
		{
			OLED_WrDat(F8X16[c*16+i]);
		}
		OLED_SetPos(x,y+1);
		for(i=0;i<8;i++)
		{
			OLED_WrDat(F8X16[c*16+i+8]);
		}
		x+=8;
		j++;
	}
}

void OLED_16x16CN(unsigned char x, unsigned char y, unsigned char N)
{
	unsigned char wm=0;
	unsigned int adder=32*N;
	OLED_SetPos(x , y);
	for(wm = 0;wm < 16;wm++)
	{
		OLED_WrDat(F16x16[adder]);
		adder += 1;
	}
	OLED_SetPos(x,y + 1);
	for(wm = 0;wm < 16;wm++)
	{
		OLED_WrDat(F16x16[adder]);
		adder += 1;
	}
}

void OLED_BMP(unsigned char x0, unsigned char y0, unsigned char x1, unsigned char y1, unsigned char BMP[])
{
	unsigned int j=0;
	unsigned char x,y;
	
  if(y1%8==0)
	{
		y=y1/8;
	}
  else
		y=y1/8+1;
	for(y=y0;y<y1;y++)
	{
		OLED_SetPos(x0,y);
    for(x=x0;x<x1;x++)
		{
			OLED_WrDat(BMP[j++]);
		}
	}
}









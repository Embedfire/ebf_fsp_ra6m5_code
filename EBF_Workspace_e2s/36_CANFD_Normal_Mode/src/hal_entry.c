#include <bsp_can_fd0.h>
#include "hal_data.h"
#include "retarget.h"
#include "bsp_uart.h"
#include "bsp_can_fd0.h"
#include "bsp_can_fd1.h"
#include "bsp_can_cfg.h"

FSP_CPP_HEADER
void R_BSP_WarmStart(bsp_warm_start_event_t event);
FSP_CPP_FOOTER


#define LED_RED_IO_PIN    BSP_IO_PORT_06_PIN_01
#define LED_GREEN_IO_PIN  BSP_IO_PORT_06_PIN_04
#define LED_BLUE_IO_PIN   BSP_IO_PORT_06_PIN_02

#define LED_RED_ON()      R_IOPORT_PinWrite(&g_ioport_ctrl, LED_RED_IO_PIN, BSP_IO_LEVEL_LOW)
#define LED_GREEN_ON()    R_IOPORT_PinWrite(&g_ioport_ctrl, LED_GREEN_IO_PIN, BSP_IO_LEVEL_LOW)
#define LED_BLUE_ON()     R_IOPORT_PinWrite(&g_ioport_ctrl, LED_BLUE_IO_PIN, BSP_IO_LEVEL_LOW)

#define LED_RED_OFF()     R_IOPORT_PinWrite(&g_ioport_ctrl, LED_RED_IO_PIN, BSP_IO_LEVEL_HIGH)
#define LED_GREEN_OFF()   R_IOPORT_PinWrite(&g_ioport_ctrl, LED_GREEN_IO_PIN, BSP_IO_LEVEL_HIGH)
#define LED_BLUE_OFF()    R_IOPORT_PinWrite(&g_ioport_ctrl, LED_BLUE_IO_PIN, BSP_IO_LEVEL_HIGH)


//extern bool b_canfd_tx_complete;
//extern bool b_canfd_rx_complete;
//extern bool b_canfd_err_status;

/* Data to be loaded in Classic CAN and FD frames for transmission and acknowledgement */
volatile uint8_t tx_data[64] = "TX_MESG";
volatile uint8_t rx_data[64] = "RX_MESG";
volatile uint8_t tx_fd0_data[64] = {0};
volatile uint8_t tx_fd1_data[64] = {0};

volatile bool canfd0_trigger_transmission = false;
volatile bool canfd1_trigger_transmission = false;


/*******************************************************************************************************************//**
 * main() is generated by the RA Configuration editor and is used to generate threads if an RTOS is used.  This function
 * is called by main() when no RTOS is used.
 **********************************************************************************************************************/
void hal_entry(void)
{
    /* TODO: add your own code here */
    __IO uint16_t temp = 0;
    fsp_err_t err = FSP_SUCCESS;

    /* 开启外部中断 */
    err = g_external_irq_on_icu.open(&g_external_irq1_ctrl, &g_external_irq1_cfg);
    assert(FSP_SUCCESS == err);
    err = g_external_irq_on_icu.enable(&g_external_irq1_ctrl);
    assert(FSP_SUCCESS == err);
    err = g_external_irq_on_icu.open(&g_external_irq2_ctrl, &g_external_irq2_cfg);
    assert(FSP_SUCCESS == err);
    err = g_external_irq_on_icu.enable(&g_external_irq2_ctrl);
    assert(FSP_SUCCESS == err);

    bsp_uart4_init();

    bsp_canfd0_init();
    bsp_canfd1_init();

    for( uint16_t j = 0; j < 64; j++)
    {
        tx_fd0_data[j] = (uint8_t) (j + 1);
    }
    for( uint16_t j = 0; j < 64; j++)
    {
        tx_fd1_data[j] = (uint8_t) (64 - j);
    }

    CANFD_PRINT("\r\n****** 这是一个 canfd 外部通讯使用实验 ******\r\n");

    CANFD_PRINT("》当前模式为：正常模式\r\n");
    CANFD_PRINT("\t按下SW2会触发canfd1传输数据\r\n");
    CANFD_PRINT("\t按下SW3会触发canfd0传输数据\r\n");

    //canfd0_operation();

    while (1) {
        /* 触发canfd0传输数据 - canfd1接收 */
        if (canfd0_trigger_transmission == true)
        {
            canfd0_trigger_transmission = false;

            /* 等待canfd1接收中断 */
            while (false == b_canfd1_rx_complete);
            b_canfd1_rx_complete = false;

            /* 检查发送和接收的数据是否相同 */
            if(0 == strncmp((char*)&canfd1_rx_frame.data[0], (char*)&tx_fd0_data[0], CAN_FD_DATA_LENGTH_CODE)) {
                CANFD_PRINT("canfd1接收到数据，且数据正确\r\n");
            } else {
                CANFD_PRINT("canfd1接收到数据，但数据不正确！！\r\n");
            }
        }

        /* 触发canfd1传输数据 - canfd0接收 */
        if (canfd1_trigger_transmission == true)
        {
            canfd1_trigger_transmission = false;

            /* 等待canfd0接收中断 */
            while (false == b_canfd0_rx_complete);
            b_canfd0_rx_complete = false;

            /* 检查发送和接收的数据是否相同 */
            if(0 == strncmp((char*)&canfd0_rx_frame.data[0], (char*)&tx_fd1_data[0], CAN_FD_DATA_LENGTH_CODE)) {
                CANFD_PRINT("canfd0接收到数据，且数据正确\r\n");
            } else {
                CANFD_PRINT("canfd1接收到数据，但数据不正确！！\r\n");
            }
        }
    }


    while(1)
    {
//        canfd1_operation();
//        R_BSP_SoftwareDelay(1, BSP_DELAY_UNITS_SECONDS);
//        if (b_canfd0_rx_complete == true) {
//            b_canfd0_rx_complete = false;
//            CANFD_PRINT("canfd0接收到数据\r\n");
//        }


        canfd0_operation();
        R_BSP_SoftwareDelay(200, BSP_DELAY_UNITS_MILLISECONDS);
//        if (b_canfd1_rx_complete == true) {
//            b_canfd1_rx_complete = false;
//            CANFD_PRINT("canfd1接收到数据\r\n");
//        }

        for( uint16_t j = 0; j < 64; j++)
        {
            tx_fd_data[j] = (uint8_t) (j + 1);
        }

        while(b_canfd1_rx_complete == false);
        b_canfd1_rx_complete = false;

        if(0 == strncmp((char*)&canfd1_rx_frame.data[0], (char*)&tx_fd_data[0], CAN_FD_DATA_LENGTH_CODE))
        {
            CANFD_PRINT("canfd1接收到数据，且数据正常\r\n");
        }



        CANFD_PRINT("\r\n\r\n\r\n");

        if (temp % 2 == 0) {
            LED_BLUE_ON();
        } else {
            LED_BLUE_OFF();
        }
        temp++;
    }

#if BSP_TZ_SECURE_BUILD
    /* Enter non-secure code */
    R_BSP_NonSecureEnter();
#endif
}

/* SW3 */
void external_irq1_callback(external_irq_callback_args_t *p_args)
{
    (void)(p_args);  //FSP_PARAMETER_NOT_USED

    canfd0_trigger_transmission = true;
    CANFD_PRINT("》SW3按键按下，触发canfd0传输数据\r\n");
    canfd0_operation();
}

/* SW2 */
void external_irq2_callback(external_irq_callback_args_t *p_args)
{
    (void)(p_args);  //FSP_PARAMETER_NOT_USED

    canfd1_trigger_transmission = true;
    CANFD_PRINT("》SW2按键按下，触发canfd1传输数据\r\n");
    canfd1_operation();
}




/*******************************************************************************************************************//**
 * This function is called at various points during the startup process.  This implementation uses the event that is
 * called right before main() to set up the pins.
 *
 * @param[in]  event    Where at in the start up process the code is currently at
 **********************************************************************************************************************/
void R_BSP_WarmStart(bsp_warm_start_event_t event)
{
    if (BSP_WARM_START_RESET == event)
    {
#if BSP_FEATURE_FLASH_LP_VERSION != 0

        /* Enable reading from data flash. */
        R_FACI_LP->DFLCTL = 1U;

        /* Would normally have to wait tDSTOP(6us) for data flash recovery. Placing the enable here, before clock and
         * C runtime initialization, should negate the need for a delay since the initialization will typically take more than 6us. */
#endif
    }

    if (BSP_WARM_START_POST_C == event)
    {
        /* C runtime environment and system clocks are setup. */

        /* Configure pins. */
        R_IOPORT_Open (&g_ioport_ctrl, g_ioport.p_cfg);
    }
}

#if BSP_TZ_SECURE_BUILD

BSP_CMSE_NONSECURE_ENTRY void template_nonsecure_callable ();

/* Trustzone Secure Projects require at least one nonsecure callable function in order to build (Remove this if it is not required to build). */
BSP_CMSE_NONSECURE_ENTRY void template_nonsecure_callable ()
{

}
#endif

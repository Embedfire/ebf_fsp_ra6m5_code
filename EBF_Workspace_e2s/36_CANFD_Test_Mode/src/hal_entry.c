#include "hal_data.h"
#include "retarget.h"
#include "bsp_uart.h"
#include "bsp_can_fd0.h"

FSP_CPP_HEADER
void R_BSP_WarmStart(bsp_warm_start_event_t event);
FSP_CPP_FOOTER


#define LED_RED_IO_PIN    BSP_IO_PORT_06_PIN_01
#define LED_GREEN_IO_PIN  BSP_IO_PORT_06_PIN_04
#define LED_BLUE_IO_PIN   BSP_IO_PORT_06_PIN_02

#define LED_RED_ON()      R_IOPORT_PinWrite(&g_ioport_ctrl, LED_RED_IO_PIN, BSP_IO_LEVEL_LOW)
#define LED_GREEN_ON()    R_IOPORT_PinWrite(&g_ioport_ctrl, LED_GREEN_IO_PIN, BSP_IO_LEVEL_LOW)
#define LED_BLUE_ON()     R_IOPORT_PinWrite(&g_ioport_ctrl, LED_BLUE_IO_PIN, BSP_IO_LEVEL_LOW)

#define LED_RED_OFF()     R_IOPORT_PinWrite(&g_ioport_ctrl, LED_RED_IO_PIN, BSP_IO_LEVEL_HIGH)
#define LED_GREEN_OFF()   R_IOPORT_PinWrite(&g_ioport_ctrl, LED_GREEN_IO_PIN, BSP_IO_LEVEL_HIGH)
#define LED_BLUE_OFF()    R_IOPORT_PinWrite(&g_ioport_ctrl, LED_BLUE_IO_PIN, BSP_IO_LEVEL_HIGH)


/*******************************************************************************************************************//**
 * main() is generated by the RA Configuration editor and is used to generate threads if an RTOS is used.  This function
 * is called by main() when no RTOS is used.
 **********************************************************************************************************************/
void hal_entry(void)
{
    fsp_err_t err = FSP_SUCCESS;

    /* 开启外部中断 */
    err = g_external_irq_on_icu.open(&g_external_irq1_ctrl, &g_external_irq1_cfg);
    assert(FSP_SUCCESS == err);
    err = g_external_irq_on_icu.enable(&g_external_irq1_ctrl);
    assert(FSP_SUCCESS == err);
    err = g_external_irq_on_icu.open(&g_external_irq2_ctrl, &g_external_irq2_cfg);
    assert(FSP_SUCCESS == err);
    err = g_external_irq_on_icu.enable(&g_external_irq2_ctrl);
    assert(FSP_SUCCESS == err);

    /* 串口4初始化 */
    bsp_uart4_init();

    /* canfd0初始化 */
    bsp_canfd0_init();
    canfd_test_mode_switch(CAN_TEST_MODE_LOOPBACK_INTERNAL);
    CANFD_PRINT("\r\n****** 这是一个canfd 测试模式实验 ******\r\n");

    CANFD_PRINT("》当前模式为：内部回环模式\r\n");
    CANFD_PRINT("\t按下SW2可切换测试模式\r\n");
    CANFD_PRINT("\t按下SW3可进行数据传输\r\n");


    while(1) {
        while(b_canfd0_rx_complete == false);
        b_canfd0_rx_complete = false;

        if(0 == strncmp((char*)&canfd0_rx_frame.data[0], (char*)&canfd0_tx_frame.data[0], CAN_FD_DATA_LENGTH_CODE))
        {
            CANFD_PRINT("》canfd0接收到数据，且数据正常\r\n");
        }
    }

#if BSP_TZ_SECURE_BUILD
    /* Enter non-secure code */
    R_BSP_NonSecureEnter();
#endif
}

/* SW3 */
void external_irq1_callback(external_irq_callback_args_t *p_args)
{
    (void)(p_args);  //FSP_PARAMETER_NOT_USED

    canfd_fd_loopback_example();
}

/* SW2 */
void external_irq2_callback(external_irq_callback_args_t *p_args)
{
    (void)(p_args);  //FSP_PARAMETER_NOT_USED
    static uint8_t _mode = 0;

    if (_mode & 0x01) {
        CANFD_PRINT("\r\n**************************\r\n");
        CANFD_PRINT("切换为内部回环模式");
        CANFD_PRINT("\r\n**************************\r\n");
        canfd_test_mode_switch(CAN_TEST_MODE_LOOPBACK_INTERNAL);
    } else {
        CANFD_PRINT("\r\n**************************\r\n");
        CANFD_PRINT("切换为外部回环模式");
        CANFD_PRINT("\r\n**************************\r\n");
        canfd_test_mode_switch(CAN_TEST_MODE_LOOPBACK_EXTERNAL);
    }
    _mode++;
}

/*******************************************************************************************************************//**
 * This function is called at various points during the startup process.  This implementation uses the event that is
 * called right before main() to set up the pins.
 *
 * @param[in]  event    Where at in the start up process the code is currently at
 **********************************************************************************************************************/
void R_BSP_WarmStart(bsp_warm_start_event_t event)
{
    if (BSP_WARM_START_RESET == event)
    {
#if BSP_FEATURE_FLASH_LP_VERSION != 0

        /* Enable reading from data flash. */
        R_FACI_LP->DFLCTL = 1U;

        /* Would normally have to wait tDSTOP(6us) for data flash recovery. Placing the enable here, before clock and
         * C runtime initialization, should negate the need for a delay since the initialization will typically take more than 6us. */
#endif
    }

    if (BSP_WARM_START_POST_C == event)
    {
        /* C runtime environment and system clocks are setup. */

        /* Configure pins. */
        R_IOPORT_Open (&g_ioport_ctrl, g_ioport.p_cfg);
    }
}

#if BSP_TZ_SECURE_BUILD

BSP_CMSE_NONSECURE_ENTRY void template_nonsecure_callable ();

/* Trustzone Secure Projects require at least one nonsecure callable function in order to build (Remove this if it is not required to build). */
BSP_CMSE_NONSECURE_ENTRY void template_nonsecure_callable ()
{

}
#endif

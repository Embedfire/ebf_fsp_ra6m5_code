#include "hal_data.h"
#include "bsp_dmac.h"

FSP_CPP_HEADER
void R_BSP_WarmStart(bsp_warm_start_event_t event);
FSP_CPP_FOOTER



#define LED_RED_IO_PIN    BSP_IO_PORT_06_PIN_01
#define LED_GREEN_IO_PIN  BSP_IO_PORT_06_PIN_04
#define LED_BLUE_IO_PIN   BSP_IO_PORT_06_PIN_02

#define LED_RED_ON()      R_IOPORT_PinWrite(&g_ioport_ctrl, LED_RED_IO_PIN, BSP_IO_LEVEL_LOW)
#define LED_GREEN_ON()    R_IOPORT_PinWrite(&g_ioport_ctrl, LED_GREEN_IO_PIN, BSP_IO_LEVEL_LOW)
#define LED_BLUE_ON()     R_IOPORT_PinWrite(&g_ioport_ctrl, LED_BLUE_IO_PIN, BSP_IO_LEVEL_LOW)

#define LED_RED_OFF()     R_IOPORT_PinWrite(&g_ioport_ctrl, LED_RED_IO_PIN, BSP_IO_LEVEL_HIGH)
#define LED_GREEN_OFF()   R_IOPORT_PinWrite(&g_ioport_ctrl, LED_GREEN_IO_PIN, BSP_IO_LEVEL_HIGH)
#define LED_BLUE_OFF()    R_IOPORT_PinWrite(&g_ioport_ctrl, LED_BLUE_IO_PIN, BSP_IO_LEVEL_HIGH)


extern const uint32_t aSRC_Const_Buffer[BUFFER_SIZE];
extern uint32_t aDST_Buffer[BUFFER_SIZE];
extern volatile bool dmac0_complete_transmission_sign;

uint8_t Buffercmp(const uint32_t* pBuffer, uint32_t* pBuffer1, uint16_t BufferLength);

/*******************************************************************************************************************//**
 * main() is generated by the RA Configuration editor and is used to generate threads if an RTOS is used.  This function
 * is called by main() when no RTOS is used.
 **********************************************************************************************************************/
void hal_entry(void)
{
    /* TODO: add your own code here */
    /* 定义存放比较结果变量 */
    __IO uint8_t TransferStatus;
    fsp_err_t err = FSP_SUCCESS;
//    uint16_t _temp = 0;

    bsp_dmac_init();
    dmac0_complete_transmission_sign = false;

    /* Enable the DMAC so that it responds to transfer requests. */
    err = g_transfer_on_dmac.enable(&g_transfer_dmac_ctrl);
    assert(FSP_SUCCESS == err);

#if (DTC_TRANSFER_MODE == DTC_TRANSFER_BLOCK_MODE)     //块模式
    err = g_transfer_on_dmac.softwareStart(&g_transfer_dmac_ctrl, TRANSFER_START_MODE_SINGLE);
    assert(FSP_SUCCESS == err);

    while (dmac0_complete_transmission_sign == false);

    /* 比较源数据与传输后数据 */
    TransferStatus = Buffercmp(aSRC_Const_Buffer, aDST_Buffer, BUFFER_SIZE);

#elif (DTC_TRANSFER_MODE == DTC_TRANSFER_NORMAL_MODE)  //正常模式 （相当于重复次数为1的重复模式）
    for (uint16_t i = 0; i < BUFFER_SIZE; i++)
    {
        err = g_transfer_on_dmac.softwareStart(&g_transfer_dmac_ctrl, TRANSFER_START_MODE_SINGLE);
        assert(FSP_SUCCESS == err);
    }

    while (dmac0_complete_transmission_sign == false);

    /* 比较源数据与传输后数据 */
    TransferStatus = Buffercmp(aSRC_Const_Buffer, aDST_Buffer, BUFFER_SIZE);

#elif (DTC_TRANSFER_MODE == DTC_TRANSFER_REPEAT_MODE)  //重复模式
    for (uint16_t i = 0; i < BUFFER_SIZE * 2; i++)
    {
        err = g_transfer_on_dmac.softwareStart(&g_transfer_dmac_ctrl, TRANSFER_START_MODE_SINGLE);
        assert(FSP_SUCCESS == err);
    }

    while (dmac0_complete_transmission_sign == false);

    /* 比较源数据与传输后数据 */
    TransferStatus += Buffercmp(aSRC_Const_Buffer, aDST_Buffer, BUFFER_SIZE);
    TransferStatus += Buffercmp(aDST_Buffer, (&aDST_Buffer[BUFFER_SIZE]), BUFFER_SIZE);
#endif

    /* 判断源数据与传输后数据比较结果*/
    if(TransferStatus == 0)
    {
        /* 源数据与传输后数据不相等时RGB彩色灯显示红色 */
        LED_RED_ON();
    }
    else
    {
        /* 源数据与传输后数据相等时RGB彩色灯显示蓝色 */
        LED_BLUE_ON();
    }

    while (1)
    {

    }

#if BSP_TZ_SECURE_BUILD
    /* Enter non-secure code */
    R_BSP_NonSecureEnter();
#endif
}

/**
  * 判断指定长度的两个数据源是否完全相等，
  * 如果完全相等返回1，只要其中一对数据不相等返回0
  */
uint8_t Buffercmp(const uint32_t* pBuffer, uint32_t* pBuffer1, uint16_t BufferLength)
{
    /* 数据长度递减 */
    while(BufferLength--)
    {
        /* 判断两个数据源是否对应相等 */
        if(*pBuffer != *pBuffer1)
        {
            /* 对应数据源不相等马上退出函数，并返回0 */
            return 0;
        }
        /* 递增两个数据源的地址指针 */
        pBuffer++;
        pBuffer1++;
    }
    /* 完成判断并且对应数据相对 */
    return 1;
}


/*******************************************************************************************************************//**
 * This function is called at various points during the startup process.  This implementation uses the event that is
 * called right before main() to set up the pins.
 *
 * @param[in]  event    Where at in the start up process the code is currently at
 **********************************************************************************************************************/
void R_BSP_WarmStart(bsp_warm_start_event_t event)
{
    if (BSP_WARM_START_RESET == event)
    {
#if BSP_FEATURE_FLASH_LP_VERSION != 0

        /* Enable reading from data flash. */
        R_FACI_LP->DFLCTL = 1U;

        /* Would normally have to wait tDSTOP(6us) for data flash recovery. Placing the enable here, before clock and
         * C runtime initialization, should negate the need for a delay since the initialization will typically take more than 6us. */
#endif
    }

    if (BSP_WARM_START_POST_C == event)
    {
        /* C runtime environment and system clocks are setup. */

        /* Configure pins. */
        R_IOPORT_Open (&g_ioport_ctrl, g_ioport.p_cfg);
    }
}

#if BSP_TZ_SECURE_BUILD

BSP_CMSE_NONSECURE_ENTRY void template_nonsecure_callable ();

/* Trustzone Secure Projects require at least one nonsecure callable function in order to build (Remove this if it is not required to build). */
BSP_CMSE_NONSECURE_ENTRY void template_nonsecure_callable ()
{

}
#endif

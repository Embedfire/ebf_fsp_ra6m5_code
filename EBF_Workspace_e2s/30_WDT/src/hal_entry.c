#include "hal_data.h"

FSP_CPP_HEADER
void R_BSP_WarmStart(bsp_warm_start_event_t event);
FSP_CPP_FOOTER

#include "wdt/bsp_wdt.h"
#include "led/bsp_led.h"

/*按键中断回调函数*/
void key1_callback(external_irq_callback_args_t *p_args)
{
   (void) p_args;

   /*按键按下触发中断，进行喂狗操作*/
   WDT_Feed();
}

/*******************************************************************************************************************//**
 * main() is generated by the RA Configuration editor and is used to generate threads if an RTOS is used.  This function
 * is called by main() when no RTOS is used.
 **********************************************************************************************************************/
void hal_entry(void)
{
    /* TODO: add your own code here */

    /*红色LED亮3秒*/
    LED1_ON;
    R_BSP_SoftwareDelay(3,BSP_DELAY_UNITS_SECONDS);

    /*按键中断初始化*/
    g_external_irq_on_icu.open(&key1_ctrl, &key1_cfg);
    g_external_irq_on_icu.enable(&key1_ctrl);

    /*初始化看门狗并开启计数器*/
    WDT_Init();

    while(1)
      {
          /*红色LED灯灭，在这里只是代指，
           *实际上这部分应该写需要被WDT监控的程序*/
          LED1_OFF;
      }



#if BSP_TZ_SECURE_BUILD
    /* Enter non-secure code */
    R_BSP_NonSecureEnter();
#endif
}

/*******************************************************************************************************************//**
 * This function is called at various points during the startup process.  This implementation uses the event that is
 * called right before main() to set up the pins.
 *
 * @param[in]  event    Where at in the start up process the code is currently at
 **********************************************************************************************************************/
void R_BSP_WarmStart(bsp_warm_start_event_t event)
{
    if (BSP_WARM_START_RESET == event)
    {
#if BSP_FEATURE_FLASH_LP_VERSION != 0

        /* Enable reading from data flash. */
        R_FACI_LP->DFLCTL = 1U;

        /* Would normally have to wait tDSTOP(6us) for data flash recovery. Placing the enable here, before clock and
         * C runtime initialization, should negate the need for a delay since the initialization will typically take more than 6us. */
#endif
    }

    if (BSP_WARM_START_POST_C == event)
    {
        /* C runtime environment and system clocks are setup. */

        /* Configure pins. */
        R_IOPORT_Open (&g_ioport_ctrl, g_ioport.p_cfg);
    }
}

#if BSP_TZ_SECURE_BUILD

BSP_CMSE_NONSECURE_ENTRY void template_nonsecure_callable ();

/* Trustzone Secure Projects require at least one nonsecure callable function in order to build (Remove this if it is not required to build). */
BSP_CMSE_NONSECURE_ENTRY void template_nonsecure_callable ()
{

}
#endif

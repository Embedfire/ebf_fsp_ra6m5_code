#include "hal_data.h"
#include "bsp_uart.h"
#include "bsp_dmac.h"

FSP_CPP_HEADER
void R_BSP_WarmStart(bsp_warm_start_event_t event);
FSP_CPP_FOOTER

#define BUFFER_SIZE  (37)

#define LED_RED_IO_PIN  BSP_IO_PORT_00_PIN_08
#define LED_GREEN_IO_PIN  BSP_IO_PORT_00_PIN_07
#define LED_BLUE_IO_PIN  BSP_IO_PORT_00_PIN_06
//#define LED_RED_IO_PIN  BSP_IO_PORT_06_PIN_01
//#define LED_GREEN_IO_PIN  BSP_IO_PORT_06_PIN_04
//#define LED_BLUE_IO_PIN  BSP_IO_PORT_06_PIN_02


void led_task(uint16_t Led_state);  //LED 闪烁任务
uint8_t Buffercmp(const uint32_t* pBuffer, uint32_t* pBuffer1, uint16_t BufferLength);


uint8_t sci_tx_data[BUFFER_SIZE] = {"embedfire-野火 www.embedfire.com\r\n"};
uint8_t sci_rx_data[BUFFER_SIZE];


extern volatile uint8_t uart_cpu_tx_complete_flag;
extern volatile uint8_t dmac_sci4_tx_flag;
extern volatile uint8_t dmac_sci4_rx_flag;


/*******************************************************************************************************************//**
 * main() is generated by the RA Configuration editor and is used to generate threads if an RTOS is used.  This function
 * is called by main() when no RTOS is used.
 **********************************************************************************************************************/
void hal_entry(void)
{
    /* TODO: add your own code here */

    fsp_err_t err = FSP_SUCCESS;

    bsp_uart4_init();  //开启串口4


    /* 通过CPU和中断处理程序发送数据 */

    err = R_SCI_UART_Write(&g_uart4_ctrl, &sci_tx_data[0], BUFFER_SIZE);
    assert(FSP_SUCCESS == err);

    /* 等待传输完成 - 标志位在 UART 的回调函数中 g_uart4_callback() */
    while( 0 == uart_cpu_tx_complete_flag );


    /* 通过 DMAC 和中断处理程序发送数据 */

    /* Clear the ICU IELSR registers that have ben populated for the UART TXI and RXI interrupts */
    R_ICU->IELSR[SCI4_RXI_IRQn] = 0U;
    R_ICU->IELSR[SCI4_TXI_IRQn] = 0U;

    /* 配置串口接收DMA 源地址、目标地址、长度 */
    set_transfer_dst_src_address(g_transfer_dmac_sci4_rx.p_cfg,
            &R_SCI4->RDR, &sci_rx_data[0]);
    set_transfer_length(g_transfer_dmac_sci4_rx.p_cfg, BUFFER_SIZE);

    /* 配置串口发送DMA 源地址、目标地址、长度 */
    set_transfer_dst_src_address(g_transfer_dmac_sci4_tx.p_cfg,
            &sci_tx_data[0], (void*)&R_SCI4->TDR);
    set_transfer_length(g_transfer_dmac_sci4_tx.p_cfg, BUFFER_SIZE);

    /* 开启DMAC */
    bsp_dmac_init();

    /* 手动触发传输数据寄存器空中断 */
    R_SCI4->SCR_b.TE = 0;
    R_SCI4->SCR_b.RE = 0;

    R_SCI4->SCR |= (0xF0);

//    /* 确保TE和TIE为0 */
//    R_SCI4->SCR_b.TE = 0;
//    R_SCI4->SCR_b.TIE = 0;
//
//    /* 读取当前SCR值，查看是否设置了RIE、RE、MPIE、CKE位 */
//    uint8_t temp = (uint8_t)(R_SCI4->SCR & 0x53);  //0x53 = 101 0011
//
//    /* 同时设置TIE和TE位，并保持RIE、RE、MPIE和CKE[1:0]。
//     * 同时设置将生成TXI中断。*/
//    R_SCI4->SCR = (uint8_t)(0xa0 | temp);  //0x0a = 1010 0000

    while (1){

        if(( 1 == dmac_sci4_tx_flag ) && ( 1 == dmac_sci4_rx_flag ))
        {
            led_task(0x07);  //RGB灯全亮 - 接收成功、发送成功
        }
        else if(( 1 == dmac_sci4_tx_flag ) && ( 0 == dmac_sci4_rx_flag ))
        {
            led_task(0x01);  //蓝色灯亮 - 接收失败、发送成功
        }
        else if(( 0 == dmac_sci4_tx_flag ) && ( 1 == dmac_sci4_rx_flag ))
        {
            led_task(0x02);  //绿色灯亮 - 接收成功、发送失败
        }
        else
        {
            led_task(0x04);  //红色灯亮 - 接收失败、发送失败
        }
    }

#if BSP_TZ_SECURE_BUILD
    /* Enter non-secure code */
    R_BSP_NonSecureEnter();
#endif
}


/**
  * 判断指定长度的两个数据源是否完全相等，
  * 如果完全相等返回1，只要其中一对数据不相等返回0
  */
uint8_t Buffercmp(const uint32_t* pBuffer, uint32_t* pBuffer1, uint16_t BufferLength)
{
    /* 数据长度递减 */
    while(BufferLength--)
    {
        /* 判断两个数据源是否对应相等 */
        if(*pBuffer != *pBuffer1)
        {
            /* 对应数据源不相等马上退出函数，并返回0 */
            return 0;
        }
        /* 递增两个数据源的地址指针 */
        pBuffer++;
        pBuffer1++;
    }
    /* 完成判断并且对应数据相对 */
    return 1;
}


void led_task(uint16_t Led_state)
{
    uint16_t _temp = Led_state;
    if ((_temp & 0x01) == 1) {
        g_ioport.p_api->pinWrite(&g_ioport_ctrl, BSP_IO_PORT_00_PIN_06, BSP_IO_LEVEL_HIGH); //评估板 LED_B
//        g_ioport.p_api->pinWrite(&g_ioport_ctrl, BSP_IO_PORT_06_PIN_01, BSP_IO_LEVEL_LOW);
    } else {
        g_ioport.p_api->pinWrite(&g_ioport_ctrl, BSP_IO_PORT_00_PIN_06, BSP_IO_LEVEL_LOW);
//        g_ioport.p_api->pinWrite(&g_ioport_ctrl, BSP_IO_PORT_06_PIN_01, BSP_IO_LEVEL_HIGH);
    }
    _temp >>= 1;
    if ((_temp & 0x01) == 1) {
        g_ioport.p_api->pinWrite(&g_ioport_ctrl, BSP_IO_PORT_00_PIN_07, BSP_IO_LEVEL_HIGH); //评估板 LED_G
//        g_ioport.p_api->pinWrite(&g_ioport_ctrl, BSP_IO_PORT_06_PIN_02, BSP_IO_LEVEL_LOW);
    } else {
        g_ioport.p_api->pinWrite(&g_ioport_ctrl, BSP_IO_PORT_00_PIN_07, BSP_IO_LEVEL_LOW);
//        g_ioport.p_api->pinWrite(&g_ioport_ctrl, BSP_IO_PORT_06_PIN_02, BSP_IO_LEVEL_HIGH);
    }
    _temp >>= 1;
    if ((_temp & 0x01) == 1) {
        g_ioport.p_api->pinWrite(&g_ioport_ctrl, BSP_IO_PORT_00_PIN_08, BSP_IO_LEVEL_HIGH); //评估板 LED_R
//        g_ioport.p_api->pinWrite(&g_ioport_ctrl, BSP_IO_PORT_06_PIN_04, BSP_IO_LEVEL_LOW);
    } else {
        g_ioport.p_api->pinWrite(&g_ioport_ctrl, BSP_IO_PORT_00_PIN_08, BSP_IO_LEVEL_LOW);
//        g_ioport.p_api->pinWrite(&g_ioport_ctrl, BSP_IO_PORT_06_PIN_04, BSP_IO_LEVEL_HIGH);
    }
}

/*******************************************************************************************************************//**
 * This function is called at various points during the startup process.  This implementation uses the event that is
 * called right before main() to set up the pins.
 *
 * @param[in]  event    Where at in the start up process the code is currently at
 **********************************************************************************************************************/
void R_BSP_WarmStart(bsp_warm_start_event_t event)
{
    if (BSP_WARM_START_RESET == event)
    {
#if BSP_FEATURE_FLASH_LP_VERSION != 0

        /* Enable reading from data flash. */
        R_FACI_LP->DFLCTL = 1U;

        /* Would normally have to wait tDSTOP(6us) for data flash recovery. Placing the enable here, before clock and
         * C runtime initialization, should negate the need for a delay since the initialization will typically take more than 6us. */
#endif
    }

    if (BSP_WARM_START_POST_C == event)
    {
        /* C runtime environment and system clocks are setup. */

        /* Configure pins. */
        R_IOPORT_Open (&g_ioport_ctrl, g_ioport.p_cfg);
    }
}

#if BSP_TZ_SECURE_BUILD

BSP_CMSE_NONSECURE_ENTRY void template_nonsecure_callable ();

/* Trustzone Secure Projects require at least one nonsecure callable function in order to build (Remove this if it is not required to build). */
BSP_CMSE_NONSECURE_ENTRY void template_nonsecure_callable ()
{

}
#endif

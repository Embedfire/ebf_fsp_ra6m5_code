#include "hal_data.h"
#include "bsp_sdhi.h"


FSP_CPP_HEADER
void R_BSP_WarmStart(bsp_warm_start_event_t event);
FSP_CPP_FOOTER


#define LED_RED_IO_PIN  BSP_IO_PORT_06_PIN_01
#define LED_GREEN_IO_PIN  BSP_IO_PORT_06_PIN_04
#define LED_BLUE_IO_PIN  BSP_IO_PORT_06_PIN_02

#define LED_RED_ON    (0x01)
#define LED_GREEN_ON  (0x02)
#define LED_BLUE_ON   (0x04)

extern uint8_t g_dest[SDHI_MAX_BLOCK_SIZE] BSP_ALIGN_VARIABLE(4);
extern uint8_t g_src[SDHI_MAX_BLOCK_SIZE] BSP_ALIGN_VARIABLE(4);

extern __IO uint32_t g_transfer_complete;
extern __IO uint32_t g_card_erase_complete;
extern __IO bool g_card_inserted;

void led_task(uint16_t Led_state);

/*******************************************************************************************************************//**
 * main() is generated by the RA Configuration editor and is used to generate threads if an RTOS is used.  This function
 * is called by main() when no RTOS is used.
 **********************************************************************************************************************/
void hal_entry(void)
{
    /* TODO: add your own code here */
    fsp_err_t err;

    r_sdhi_basic_example();

//    fsp_err_t err = g_sdmmc_on_sdhi.erase(&g_sdmmc0_ctrl, 1, 1);
//    assert(FSP_SUCCESS == err);
//    R_BSP_SoftwareDelay(500, BSP_DELAY_UNITS_MILLISECONDS);
//    R_BSP_SoftwareDelay(500, BSP_DELAY_UNITS_MILLISECONDS);
//    R_BSP_SoftwareDelay(500, BSP_DELAY_UNITS_MILLISECONDS);
////    while (g_card_erase_complete == 0);
////    g_card_erase_complete = 0;
//
//    err = g_sdmmc_on_sdhi.read(&g_sdmmc0_ctrl, g_dest, 1, 1);
//    assert(FSP_SUCCESS == err);
//    while (g_transfer_complete == 0);
//    g_transfer_complete = 0;

    /* 写数据量很大，执行时间20分钟左右 */
//    for (uint32_t i = 0; i < 1000000; i++)
//    {
//        err = g_sdmmc_on_sdhi.write(&g_sdmmc0_ctrl, g_src, i, 1);
//        assert(FSP_SUCCESS == err);
//        while (g_transfer_complete == 0);
//        g_transfer_complete = 0;
//    }

    if(0 == strncmp((char*)&g_dest[0], (char*)&g_src[0], 1)) {
        led_task(LED_BLUE_ON);
    } else {
        led_task(LED_RED_ON);
    }

    while(1);

#if BSP_TZ_SECURE_BUILD
    /* Enter non-secure code */
    R_BSP_NonSecureEnter();
#endif
}


void led_task(uint16_t Led_state)
{
    uint16_t _temp = Led_state;
    if ((_temp & 0x01) == 1) {
        g_ioport.p_api->pinWrite(&g_ioport_ctrl, LED_RED_IO_PIN, BSP_IO_LEVEL_LOW);
    } else {
        g_ioport.p_api->pinWrite(&g_ioport_ctrl, LED_RED_IO_PIN, BSP_IO_LEVEL_HIGH);
    }
    _temp >>= 1;
    if ((_temp & 0x01) == 1) {
        g_ioport.p_api->pinWrite(&g_ioport_ctrl, LED_GREEN_IO_PIN, BSP_IO_LEVEL_LOW);
    } else {
        g_ioport.p_api->pinWrite(&g_ioport_ctrl, LED_GREEN_IO_PIN, BSP_IO_LEVEL_HIGH);
    }
    _temp >>= 1;
    if ((_temp & 0x01) == 1) {
        g_ioport.p_api->pinWrite(&g_ioport_ctrl, LED_BLUE_IO_PIN, BSP_IO_LEVEL_LOW);
    } else {
        g_ioport.p_api->pinWrite(&g_ioport_ctrl, LED_BLUE_IO_PIN, BSP_IO_LEVEL_HIGH);
    }
}

/*******************************************************************************************************************//**
 * This function is called at various points during the startup process.  This implementation uses the event that is
 * called right before main() to set up the pins.
 *
 * @param[in]  event    Where at in the start up process the code is currently at
 **********************************************************************************************************************/
void R_BSP_WarmStart(bsp_warm_start_event_t event)
{
    if (BSP_WARM_START_RESET == event)
    {
#if BSP_FEATURE_FLASH_LP_VERSION != 0

        /* Enable reading from data flash. */
        R_FACI_LP->DFLCTL = 1U;

        /* Would normally have to wait tDSTOP(6us) for data flash recovery. Placing the enable here, before clock and
         * C runtime initialization, should negate the need for a delay since the initialization will typically take more than 6us. */
#endif
    }

    if (BSP_WARM_START_POST_C == event)
    {
        /* C runtime environment and system clocks are setup. */

        /* Configure pins. */
        R_IOPORT_Open (&g_ioport_ctrl, g_ioport.p_cfg);
    }
}

#if BSP_TZ_SECURE_BUILD

BSP_CMSE_NONSECURE_ENTRY void template_nonsecure_callable ();

/* Trustzone Secure Projects require at least one nonsecure callable function in order to build (Remove this if it is not required to build). */
BSP_CMSE_NONSECURE_ENTRY void template_nonsecure_callable ()
{

}
#endif

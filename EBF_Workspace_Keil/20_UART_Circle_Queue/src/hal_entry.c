#include "hal_data.h"
#include "bsp_uart.h"
#include "bsp_circular_queue.h"
#include "stdio.h"
#include "stdlib.h"

FSP_CPP_HEADER
void R_BSP_WarmStart(bsp_warm_start_event_t event);
FSP_CPP_FOOTER

/*******************************************************************************************************************//**
 * main() is generated by the RA Configuration editor and is used to generate threads if an RTOS is used.  This function
 * is called by main() when no RTOS is used.
 **********************************************************************************************************************/
void hal_entry(void)
{
    /* TODO: add your own code here */
		Queue_Init((Circular_queue_t*)&Circular_queue); //环形队列初始化
    UART_Init(); //串口初始化并开始接收
    uint8_t Read_buffer[DATA_LEN];

    while(1)
    {
        if(uart_receiving>0) //大于0则表示串口正在接收
        {
            if(uart_receiving == 1)  //当这个变量等于1则表明串口接收完成，开始打印队列中的所有数据
            {
                memset(Read_buffer,0,DATA_LEN);
                /*这里会Warning，但不能强制转换，否则可能会被编译器优化*/
                Queue_Read(&Circular_queue, Read_buffer, Queue_HadUse(&Circular_queue));
                printf("%s\r\n",Read_buffer);
            }
            uart_receiving--;   //在主函数中递减这个变量，但在串口中断回调函数中会被赋值为5
        }
        R_BSP_SoftwareDelay(1, BSP_DELAY_UNITS_MILLISECONDS); //延时1ms
    }
#if BSP_TZ_SECURE_BUILD
    /* Enter non-secure code */
    R_BSP_NonSecureEnter();
#endif
}

/*******************************************************************************************************************//**
 * This function is called at various points during the startup process.  This implementation uses the event that is
 * called right before main() to set up the pins.
 *
 * @param[in]  event    Where at in the start up process the code is currently at
 **********************************************************************************************************************/
void R_BSP_WarmStart (bsp_warm_start_event_t event)
{
    if (BSP_WARM_START_RESET == event)
    {
#if BSP_FEATURE_FLASH_LP_VERSION != 0

        /* Enable reading from data flash. */
        R_FACI_LP->DFLCTL = 1U;

        /* Would normally have to wait tDSTOP(6us) for data flash recovery. Placing the enable here, before clock and
         * C runtime initialization, should negate the need for a delay since the initialization will typically take more than 6us. */
#endif
    }

    if (BSP_WARM_START_POST_C == event)
    {
        /* C runtime environment and system clocks are setup. */

        /* Configure pins. */
        R_IOPORT_Open(&g_ioport_ctrl, g_ioport.p_cfg);
    }
}

#if BSP_TZ_SECURE_BUILD

BSP_CMSE_NONSECURE_ENTRY void template_nonsecure_callable ();

/* Trustzone Secure Projects require at least one nonsecure callable function in order to build (Remove this if it is not required to build). */
BSP_CMSE_NONSECURE_ENTRY void template_nonsecure_callable ()
{

}
#endif
